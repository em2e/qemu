## hw/robonaut/Kconfig
```kconfig
config STM32F446_SOC
    bool
    select ARM_V7M
    select OR_IRQ
    select UNIMP
    select STM32F2XX_TIMER
    select STM32F2XX_USART
    select STM32F4XX_SYSCFG
    select STM32F4XX_EXTI
    select STM32F2XX_ADC
    select STM32F2XX_SPI

config NUCLEO_F446
    bool
    select STM32F446_SOC

config ROBONAUT
    bool
    select NUCLEO_F446
```
